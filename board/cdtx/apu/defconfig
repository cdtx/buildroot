## board/cdtx/apu/defconfig
```kconfig
BR2_DEPRECATED=y
BR2_UCLIBC_CONFIG="$(TOPDIR)/package/uclibc/uClibc-0.9.33.config"
BR2_TOOLCHAIN_BUILDROOT_LARGEFILE=y
BR2_TOOLCHAIN_BUILDROOT_INET_IPV6=y
BR2_TOOLCHAIN_BUILDROOT_INET_RPC=y
BR2_TOOLCHAIN_BUILDROOT_WCHAR=y
BR2_BINUTILS_VERSION_2_24=y
BR2_TOOLCHAIN_BUILDROOT_CXX=y
BR2_TARGET_GENERIC_HOSTNAME="apu"
BR2_TARGET_GENERIC_ISSUE="Welcome at the mini-market"
BR2_TARGET_GENERIC_ROOT_PASSWD="root"
BR2_TARGET_GENERIC_GETTY_PORT="tty1"
BR2_ROOTFS_OVERLAY="board/cdtx/apu/fs-overlay"
BR2_ROOTFS_POST_BUILD_SCRIPT="board/cdtx/apu/post-build-scripts/feu.sh"
BR2_LINUX_KERNEL=y
BR2_LINUX_KERNEL_SAME_AS_HEADERS=y
BR2_LINUX_KERNEL_USE_CUSTOM_CONFIG=y
BR2_LINUX_KERNEL_CUSTOM_CONFIG_FILE="$(TOPDIR)/board/cdtx/apu/linux.config"
BR2_PACKAGE_BUSYBOX_CONFIG="$(TOPDIR)/board/cdtx/apu/busybox.config"
BR2_PACKAGE_BUSYBOX_SHOW_OTHERS=y
BR2_PACKAGE_INFOZIP=y
BR2_PACKAGE_LZOP=y
BR2_PACKAGE_BINUTILS=y
BR2_PACKAGE_BINUTILS_TARGET=y
BR2_PACKAGE_GIT=y
BR2_PACKAGE_MAKE=y
BR2_PACKAGE_PATCH=y
BR2_PACKAGE_SUBVERSION=y
BR2_PACKAGE_CIFS_UTILS=y
BR2_PACKAGE_CRAMFS=y
BR2_PACKAGE_DOSFSTOOLS=y
BR2_PACKAGE_DOSFSTOOLS_FATLABEL=y
BR2_PACKAGE_DOSFSTOOLS_FSCK_FAT=y
BR2_PACKAGE_DOSFSTOOLS_MKFS_FAT=y
BR2_PACKAGE_E2FSPROGS=y
BR2_PACKAGE_E2FSPROGS_RESIZE2FS=y
BR2_PACKAGE_GENEXT2FS=y
BR2_PACKAGE_MAKEDEVS=y
BR2_PACKAGE_SQUASHFS=y
BR2_PACKAGE_SQUASHFS_LZMA=y
BR2_PACKAGE_SQUASHFS_LZO=y
BR2_PACKAGE_SQUASHFS_XZ=y
BR2_PACKAGE_SSHFS=y
BR2_PACKAGE_LINUX_FIRMWARE=y
BR2_PACKAGE_LINUX_FIRMWARE_RALINK_RT61=y
BR2_PACKAGE_LINUX_FIRMWARE_RALINK_RT73=y
BR2_PACKAGE_LINUX_FIRMWARE_RALINK_RT2XX=y
BR2_PACKAGE_LINUX_FIRMWARE_BNX2X=y
BR2_PACKAGE_HWDATA=y
BR2_PACKAGE_PARTED=y
BR2_PACKAGE_USBUTILS=y
BR2_PACKAGE_PYTHON=y
BR2_PACKAGE_PYTHON_BZIP2=y
BR2_PACKAGE_PYTHON_CURSES=y
BR2_PACKAGE_PYTHON_ZLIB=y
BR2_PACKAGE_PYTHON_HASHLIB=y
BR2_PACKAGE_LIBFTDI=y
BR2_PACKAGE_LIBHID=y
BR2_PACKAGE_LIBSERIAL=y
BR2_PACKAGE_LIBCURL=y
BR2_PACKAGE_LIBNFNETLINK=y
BR2_PACKAGE_LIBPCAP=y
BR2_PACKAGE_LIBEVENT=y
BR2_PACKAGE_DNSMASQ=y
BR2_PACKAGE_DROPBEAR=y
BR2_PACKAGE_HOSTAPD=y
BR2_PACKAGE_HOSTAPD_EAP=y
BR2_PACKAGE_HOSTAPD_WPS=y
BR2_PACKAGE_IFPLUGD=y
BR2_PACKAGE_IPTABLES=y
BR2_PACKAGE_IPUTILS=y
BR2_PACKAGE_IW=y
BR2_PACKAGE_NETPLUG=y
BR2_PACKAGE_NTP=y
# BR2_PACKAGE_NTP_NTPD is not set
BR2_PACKAGE_WIRELESS_TOOLS=y
BR2_PACKAGE_OPKG=y
BR2_PACKAGE_OPKG_GPG_SIGN=y
BR2_PACKAGE_AT=y
BR2_PACKAGE_DIALOG=y
BR2_PACKAGE_DTACH=y
BR2_PACKAGE_FILE=y
BR2_PACKAGE_ACL=y
BR2_PACKAGE_KMOD=y
BR2_TARGET_ROOTFS_CPIO=y
BR2_TARGET_ROOTFS_EXT2=y
BR2_TARGET_GRUB=y
BR2_TARGET_GRUB_SPLASH=y
BR2_TARGET_GRUB_DISKLESS=y
BR2_TARGET_GRUB_FS_ISO9660=y
BR2_TARGET_SYSLINUX=y
# BR2_TARGET_SYSLINUX_ISOLINUX is not set
BR2_PACKAGE_HOST_DOSFSTOOLS=y
BR2_PACKAGE_HOST_PARTED=y
BR2_PACKAGE_HOST_SAM_BA=y
BR2_PACKAGE_HOST_SQUASHFS=y
BR2_PACKAGE_HOST_UBOOT_TOOLS=y
BR2_PACKAGE_HOST_UTIL_LINUX=y
```
